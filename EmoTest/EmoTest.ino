// EmoTest - test every EMO face and its sound
// Board: Waveshare ESP32-C6-LCD-1.47 (ST7789 172x320, landscape)
// Audio: MAX98357A I2S amplifier + 4-8 ohm speaker
//
//   BOOT press      -> next face (speaks its phrase)
//   BOOT hold 1s    -> auto demo on/off (cycles faces every 3s)

#include <Arduino_GFX_Library.h>
#include <ESP_I2S.h>

// ---- Display pins (fixed on this board) ----
#define PIN_MOSI 6
#define PIN_SCLK 7
#define PIN_CS   14
#define PIN_DC   15
#define PIN_RST  21
#define PIN_BL   22
#define PIN_LED  8   // onboard WS2812
#define PIN_BTN  9   // BOOT button

// ---- MAX98357A pins (do not use the SD card slot: it shares 4/5) ----
#define PIN_I2S_BCLK 4
#define PIN_I2S_LRC  5
#define PIN_I2S_DIN  17

#include "voices.h"   // spoken phrases, one per mood (generated by tools/make_voices.py)

#define SAMPLE_RATE VOICE_RATE
// MAX98357A pushes ~3W at 5V. With a 3W speaker 0.3 is safe; tiny 0.5-1W speakers need <= 0.1
#define VOLUME 0.075f  // 0.0 - 1.0

#define W 320
#define H 172
#define BLACK 0x0000

Arduino_DataBus *bus = new Arduino_ESP32SPI(PIN_DC, PIN_CS, PIN_SCLK, PIN_MOSI, GFX_NOT_DEFINED);
Arduino_GFX *panel = new Arduino_ST7789(bus, PIN_RST, 1, true, 172, 320, 34, 0, 34, 0);
Arduino_Canvas *gfx = new Arduino_Canvas(W, H, panel);

static inline float approach(float c, float t, float k) { return c + (t - c) * k; }
void led(uint8_t r, uint8_t g, uint8_t b) { rgbLedWrite(PIN_LED, r / 4, g / 4, b / 4); }

enum Mood { NORMAL, HAPPY, ANGRY, SAD, TIRED, SURPRISED, LOVE, SUSPICIOUS, MOOD_COUNT };
const char *moodNames[] = {"NORMAL", "HAPPY", "ANGRY", "SAD", "TIRED", "SURPRISED", "LOVE", "SUSPICIOUS"};

// ============================================================
// Audio: robot voice synthesizer running in its own task
// ============================================================
namespace Audio {
I2SClass i2s;
QueueHandle_t q;
volatile bool abortSnd = false;
volatile float level = 0;   // for the on-screen equalizer
bool ok = false;

enum Wave { SINE, SQUARE, TRI };
const int CHUNK = 128;
int16_t buf[CHUNK * 2];
float phase = 0;
volatile unsigned long written = 0;  // bytes sent to I2S, for diagnostics
const int TEST_TONE = 100;

// Play a tone gliding from f0 to f1 Hz over ms, with optional vibrato
bool tone(float f0, float f1, int ms, Wave w = SINE, float vol = 1, float vibHz = 0, float vibDepth = 0) {
  int n = (long)SAMPLE_RATE * ms / 1000;
  int att = SAMPLE_RATE * 5 / 1000, rel = SAMPLE_RATE * 20 / 1000;
  for (int i = 0; i < n; i += CHUNK) {
    if (abortSnd) return false;
    float peak = 0;
    for (int j = 0; j < CHUNK; j++) {
      int k = i + j;
      float s = 0;
      if (k < n) {
        float t = (float)k / n;
        float f = f0 + (f1 - f0) * t;
        if (vibHz > 0) f *= 1 + vibDepth * sinf(2 * PI * vibHz * k / SAMPLE_RATE);
        phase += f / SAMPLE_RATE;
        if (phase >= 1) phase -= 1;
        switch (w) {
          case SINE:   s = sinf(2 * PI * phase); break;
          case SQUARE: s = phase < 0.5f ? 0.6f : -0.6f; break;
          case TRI:    s = 4 * fabsf(phase - 0.5f) - 1; break;
        }
        float env = 1;
        if (k < att) env = (float)k / att;
        else if (k > n - rel) env = (float)(n - k) / rel;
        s *= env * vol * VOLUME;
      }
      peak = max(peak, fabsf(s));
      int16_t v = s * 32767;
      buf[j * 2] = v; buf[j * 2 + 1] = v;   // same on L and R
    }
    level = peak / VOLUME;
    written += i2s.write((uint8_t *)buf, sizeof(buf));
  }
  return true;
}

bool rest(int ms) { return tone(0, 0, ms, SINE, 0); }

void testTone() {
  if (!ok) return;
  abortSnd = true;
  xQueueReset(q);
  int v = TEST_TONE;
  xQueueSend(q, &v, 0);
}

void silence() {
  memset(buf, 0, sizeof(buf));
  for (int i = 0; i < 16; i++) i2s.write((uint8_t *)buf, sizeof(buf));
  level = 0;
}

// Play a recorded voice clip
void speak(Mood m) {
  const VoiceClip &v = voices[m];
  for (uint32_t i = 0; i < v.len; i += CHUNK) {
    if (abortSnd) return;
    float peak = 0;
    for (int j = 0; j < CHUNK; j++) {
      float s = (i + j < v.len) ? v.data[i + j] / 32768.0f : 0;
      peak = max(peak, fabsf(s));
      int16_t o = s * VOLUME * 32767;
      buf[j * 2] = o; buf[j * 2 + 1] = o;
    }
    level = peak;
    written += i2s.write((uint8_t *)buf, sizeof(buf));
  }
}

// Robot beeps for each mood
void beeps(Mood m) {
  switch (m) {
    case NORMAL:     // "bi-bip"
      tone(1200, 1300, 70) && rest(40) && tone(1600, 1700, 90);
      break;
    case HAPPY:      // rising chirpy arpeggio
      tone(523, 600, 80, TRI) && tone(659, 750, 80, TRI) && tone(784, 900, 80, TRI) &&
      tone(1047, 1400, 180, TRI, 1, 12, 0.03f);
      break;
    case ANGRY:      // low grumbling growl
      tone(180, 140, 250, SQUARE, 0.8f, 18, 0.15f) && rest(30) && tone(160, 90, 350, SQUARE, 0.8f, 22, 0.2f);
      break;
    case SAD:        // slow descending "ooohh"
      tone(800, 500, 450, SINE, 1, 5, 0.04f) && tone(500, 280, 600, SINE, 0.8f, 4, 0.05f);
      break;
    case TIRED:      // yawn
      tone(300, 650, 500, TRI, 0.8f) && tone(650, 200, 800, TRI, 0.7f, 3, 0.03f);
      break;
    case SURPRISED:  // fast "whoop!"
      tone(400, 2200, 220, SINE) && rest(30) && tone(2000, 2100, 80);
      break;
    case LOVE:       // warm "awww" + heartbeat
      tone(600, 900, 350, SINE, 1, 6, 0.03f) && tone(900, 700, 300, SINE, 0.9f, 6, 0.03f) && rest(120) &&
      tone(120, 90, 90, SINE, 1) && rest(60) && tone(120, 90, 120, SINE, 1);
      break;
    case SUSPICIOUS: // "hmm... ?"
      tone(450, 430, 400, TRI, 0.8f) && rest(80) && tone(500, 900, 220, TRI);
      break;
    default: break;
  }
}

bool useVoice = true;

void play(Mood m) {
  if (useVoice) speak(m); else beeps(m);
  silence();
}

void task(void *) {
  int m;
  for (;;) if (xQueueReceive(q, &m, portMAX_DELAY)) {
    abortSnd = false;
    if (m == TEST_TONE) { tone(1000, 1000, 400, SINE, 0.7f); silence(); }
    else play((Mood)m);
  }
}

void begin() {
  i2s.setPins(PIN_I2S_BCLK, PIN_I2S_LRC, PIN_I2S_DIN);
  ok = i2s.begin(I2S_MODE_STD, SAMPLE_RATE, I2S_DATA_BIT_WIDTH_16BIT, I2S_SLOT_MODE_STEREO);
  if (!ok) { Serial.println("I2S init failed"); return; }
  q = xQueueCreate(4, sizeof(int));
  xTaskCreate(task, "audio", 4096, nullptr, 5, nullptr);
}

void say(Mood m) {
  if (!ok) return;
  abortSnd = true;          // cut off the current sound
  xQueueReset(q);
  int v = m;
  xQueueSend(q, &v, 0);
}
}

// ============================================================
// Face (EMO eyes)
// ============================================================
namespace Face {
struct Eye { float x, y, w, h, tx, ty, tw, th; };
Eye L, R;
Mood mood = NORMAL;
uint16_t col = 0x07FF;
uint8_t lr = 0, lg = 255, lb = 255;
float tLookX = 0, tLookY = 0, blink = 1, lid = 0, tLid = 0, bounce = 0;
int blinkPhase = 0;
unsigned long nextBlink, nextLook;
const float BW = 70, BH = 80, GAP = 46;

void targets() {
  float lw = BW, lh = BH, rw = BW, rh = BH;
  switch (mood) {
    case SURPRISED:  lw = rw = 82; lh = rh = 96; break;
    case HAPPY:      lh = rh = 70; break;
    case TIRED:      lh = rh = 60; break;
    case SUSPICIOUS: lh = 46; rh = 84; break;
    case LOVE:       lw = rw = lh = rh = 76; break;
    default: break;
  }
  float p = tLookX * 0.12f;
  L.tw = lw * (1 - p); L.th = lh * (1 - p);
  R.tw = rw * (1 + p); R.th = rh * (1 + p);
  float cx = W / 2 + tLookX * 50, cy = H / 2 + tLookY * 30;
  L.tx = cx - GAP / 2 - BW / 2;
  R.tx = cx + GAP / 2 + BW / 2;
  L.ty = R.ty = cy;
  tLid = (mood == ANGRY || mood == SAD || mood == TIRED || mood == HAPPY) ? 1 : 0;
}

void setMood(Mood m) {
  mood = m;
  switch (m) {
    case ANGRY: col = 0xF800; lr = 255; lg = 0;   lb = 0;   break;
    case SAD:   col = 0x3D9F; lr = 40;  lg = 80;  lb = 255; break;
    case LOVE:  col = 0xF8B2; lr = 255; lg = 30;  lb = 120; break;
    case TIRED: col = 0x04BF; lr = 0;   lg = 40;  lb = 120; break;
    case HAPPY: col = 0x07FF; lr = 255; lg = 200; lb = 0;   break;
    default:    col = 0x07FF; lr = 0;   lg = 255; lb = 255; break;
  }
  lid = 0;
  tLookX = tLookY = 0;   // look at the viewer when the face changes
  nextLook = millis() + 1500;
  targets();
}

void heart(float cx, float cy, float s) {
  float r = s * 0.28f;
  gfx->fillCircle(cx - r, cy - r * 0.4f, r, col);
  gfx->fillCircle(cx + r, cy - r * 0.4f, r, col);
  gfx->fillTriangle(cx - 2 * r, cy - r * 0.1f, cx + 2 * r, cy - r * 0.1f, cx, cy + s * 0.55f, col);
}

void eye(const Eye &e, bool left) {
  float h = max(4.0f, e.h * blink);
  int x = e.x - e.w / 2, y = e.y - h / 2, w = e.w, hh = h;
  if (mood == LOVE && blink > 0.5f) { heart(e.x, e.y, e.w * (1 + 0.08f * sinf(millis() / 120.0f))); return; }
  int r = max(2, min(w, hh) / 4);
  gfx->fillRoundRect(x, y, w, hh, r, col);
  if (lid < 0.02f || blink < 0.3f) return;
  switch (mood) {
    case ANGRY: { int d = hh * 0.55f * lid;
      if (left) gfx->fillTriangle(x - 1, y - 1, x + w + 1, y - 1, x + w + 1, y + d, BLACK);
      else      gfx->fillTriangle(x - 1, y - 1, x + w + 1, y - 1, x - 1, y + d, BLACK); break; }
    case SAD: { int d = hh * 0.5f * lid;
      if (left) gfx->fillTriangle(x - 1, y - 1, x + w + 1, y - 1, x - 1, y + d, BLACK);
      else      gfx->fillTriangle(x - 1, y - 1, x + w + 1, y - 1, x + w + 1, y + d, BLACK); break; }
    case TIRED: gfx->fillRect(x - 1, y - 1, w + 2, hh * 0.45f * lid, BLACK); break;
    case HAPPY: { int off = hh * 0.55f * lid;
      gfx->fillRoundRect(x - 2, y + hh - off, w + 4, hh, r, BLACK);
      gfx->fillCircle(e.x, y + hh + w * 0.35f - off, w * 0.62f, BLACK); break; }
    default: break;
  }
}

void mouth() {
  int cx = (L.x + R.x) / 2, y = max(L.y + L.h * blink / 2, R.y + R.h * blink / 2) + 14;
  if (y > H - 20) return;
  if (mood == HAPPY) gfx->fillArc(cx, y - 6, 14, 10, 20, 160, col);
  else if (mood == SURPRISED) { gfx->fillCircle(cx, y + 2, 7, col); gfx->fillCircle(cx, y + 2, 3, BLACK); }
  else if (mood == SAD) gfx->fillArc(cx, y + 14, 14, 10, 200, 340, col);
}

void begin() {
  L = {W / 2.0f - 58, H / 2.0f, BW, 4};
  R = {W / 2.0f + 58, H / 2.0f, BW, 4};
  setMood(NORMAL);
  nextBlink = millis() + 1200;
}

void frame() {
  unsigned long now = millis();
  if (blinkPhase == 0 && now > nextBlink) blinkPhase = 1;
  if (blinkPhase == 1) { blink -= 0.25f; if (blink <= 0) { blink = 0; blinkPhase = 2; } }
  else if (blinkPhase == 2) { blink += 0.2f;
    if (blink >= 1) { blink = 1; blinkPhase = 0; nextBlink = now + (random(5) == 0 ? 120 : random(2000, 5000)); } }
  if (now > nextLook) {
    if (random(3) == 0) tLookX = tLookY = 0;
    else { tLookX = random(-100, 101) / 100.0f; tLookY = random(-100, 101) / 100.0f; }
    targets();
    nextLook = now + random(800, 3000);
  }

  const float k = 0.22f;
  L.x = approach(L.x, L.tx, k); L.y = approach(L.y, L.ty, k); L.w = approach(L.w, L.tw, k); L.h = approach(L.h, L.th, k);
  R.x = approach(R.x, R.tx, k); R.y = approach(R.y, R.ty, k); R.w = approach(R.w, R.tw, k); R.h = approach(R.h, R.th, k);
  lid = approach(lid, tLid, 0.15f);
  if (mood == HAPPY || mood == LOVE) { float b = sinf(now / 150.0f) * 4; L.y += b - bounce; R.y += b - bounce; bounce = b; }
  else bounce = 0;
  if (mood == ANGRY && lid > 0.8f) { float s = random(-2, 3); L.x += s; R.x += s; }

  gfx->fillScreen(BLACK);
  eye(L, true); eye(R, false); mouth();
  if (mood == TIRED && (now / 600) % 2) {
    gfx->setTextColor(col); gfx->setTextSize(2);
    gfx->setCursor(R.x + 40, R.y - 60); gfx->print("z");
  }
  float p = (mood == LOVE) ? 0.5f + 0.5f * sinf(now / 120.0f) : blink;
  led(lr * p, lg * p, lb * p);
}
}

// ============================================================
// Test UI
// ============================================================
int cur = 0;
bool autoDemo = false, lastBtn = HIGH, holdHandled = true;
unsigned long btnTime = 0, lastFrame = 0, labelUntil = 0, nextAuto = 0;
float eq[5] = {0};

void selectFace(int m) {
  cur = m;
  Face::setMood((Mood)m);
  Audio::say((Mood)m);
  labelUntil = millis() + 1800;
  Serial.printf("Face %d/%d: %s\n", m + 1, MOOD_COUNT, moodNames[m]);
}

void drawUI() {
  unsigned long now = millis();
  // Face name pill
  if (now < labelUntil) {
    char s[32];
    snprintf(s, sizeof s, "%d/%d %s", cur + 1, MOOD_COUNT, moodNames[cur]);
    gfx->setTextSize(2);
    int w = strlen(s) * 12;
    gfx->fillRoundRect(W / 2 - w / 2 - 8, 4, w + 16, 24, 6, 0x2104);
    gfx->setTextColor(0xFFFF);
    gfx->setCursor(W / 2 - w / 2, 9);
    gfx->print(s);
  }
  // Speaker equalizer
  float lv = Audio::level;
  for (int i = 0; i < 5; i++) {
    float target = lv * (0.5f + 0.5f * sinf(now / 60.0f + i * 1.7f));
    eq[i] = approach(eq[i], target, 0.4f);
    int h = 2 + eq[i] * 18;
    gfx->fillRect(286 + i * 6, H - 6 - h, 4, h, lv > 0.01f ? Face::col : 0x4208);
  }
  // Hints
  gfx->setTextSize(1);
  gfx->setTextColor(0x6B4D);
  gfx->setCursor(6, H - 12);
  gfx->print(autoDemo ? "AUTO  (hold BOOT: stop)" : "BOOT: next  hold: auto");
  if (!Audio::ok) { gfx->setTextColor(0xF800); gfx->setCursor(6, 6); gfx->print("I2S ERROR"); }
}

void setup() {
  Serial.begin(115200);
  analogWrite(PIN_BL, 255);
  pinMode(PIN_BTN, INPUT_PULLUP);
  if (!gfx->begin(80000000)) Serial.println("Display init failed");
  randomSeed(esp_random());
  Audio::begin();
  Face::begin();
  selectFace(0);
}

void loop() {
  unsigned long now = millis();

  bool b = digitalRead(PIN_BTN);
  if (b == LOW && lastBtn == HIGH && now - btnTime > 60) { btnTime = now; holdHandled = false; }
  if (b == LOW && !holdHandled && now - btnTime > 1000) {   // long press
    holdHandled = true;
    autoDemo = !autoDemo;
    nextAuto = now + 3000;
    Serial.printf("Auto demo %s\n", autoDemo ? "on" : "off");
  }
  if (b == HIGH && lastBtn == LOW && !holdHandled) {        // short press (on release)
    holdHandled = true;
    selectFace((cur + 1) % MOOD_COUNT);
    nextAuto = now + 3000;
  }
  lastBtn = b;

  if (autoDemo && now > nextAuto) { selectFace((cur + 1) % MOOD_COUNT); nextAuto = now + 3000; }

  // Diagnostics over USB serial: 't' = short 1kHz test tone, 'n' = next face, 'v' = voice/beeps
  while (Serial.available()) {
    char c = Serial.read();
    if (c == 'v') { Audio::useVoice = !Audio::useVoice; Serial.println(Audio::useVoice ? "Voice" : "Beeps"); }
    if (c == 't') { Serial.println("Test tone 1kHz 0.4s"); Audio::testTone(); }
    if (c == 'n') selectFace((cur + 1) % MOOD_COUNT);
  }
  static unsigned long lastStatus = 0;
  if (now - lastStatus > 3000) {
    lastStatus = now;
    Serial.printf("I2S %s  BCLK=%d LRC=%d DIN=%d  bytes sent=%lu\n", Audio::ok ? "OK" : "FAILED",
                  PIN_I2S_BCLK, PIN_I2S_LRC, PIN_I2S_DIN, Audio::written);
  }

  if (now - lastFrame < 16) return;
  lastFrame = now;
  Face::frame();
  drawUI();
  gfx->flush();
}
