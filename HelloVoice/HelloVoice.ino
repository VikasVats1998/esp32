// HelloVoice - says "Hello world!" through a MAX98357A
// Board: Waveshare ESP32-C6-LCD-1.47
// Wiring: BCLK=GPIO4, LRC=GPIO5, DIN=RXD(GPIO17), VIN=5V, GND=GND, SD=3V3
// Plays at power-on and every time BOOT is pressed.

#include <Arduino_GFX_Library.h>
#include <ESP_I2S.h>
#include "voices.h"   // generated by EmoTest/tools/make_voices.py

#define PIN_MOSI 6
#define PIN_SCLK 7
#define PIN_CS   14
#define PIN_DC   15
#define PIN_RST  21
#define PIN_BL   22
#define PIN_BTN  9

#define PIN_I2S_BCLK 4
#define PIN_I2S_LRC  5
#define PIN_I2S_DIN  17

#define VOLUME 0.075f  // 3W speaker: keep <= 0.4

Arduino_DataBus *bus = new Arduino_ESP32SPI(PIN_DC, PIN_CS, PIN_SCLK, PIN_MOSI, GFX_NOT_DEFINED);
Arduino_GFX *gfx = new Arduino_ST7789(bus, PIN_RST, 1, true, 172, 320, 34, 0, 34, 0);
I2SClass i2s;
int16_t buf[256];
int count = 0;

void screen(bool speaking) {
  gfx->fillScreen(0x0000);
  gfx->setTextSize(4);
  gfx->setTextColor(speaking ? 0x07FF : 0x4208);
  gfx->setCursor(40, 45);  gfx->print("Hello");
  gfx->setCursor(40, 90);  gfx->print("world!");
  gfx->setTextSize(1);
  gfx->setTextColor(0x8410);
  gfx->setCursor(40, 150);
  gfx->printf("press BOOT to hear it again   (%d)", count);
}

void playClip(const VoiceClip &v) {
  for (uint32_t i = 0; i < v.len; i += 128) {
    for (int j = 0; j < 128; j++) {
      int16_t s = (i + j < v.len) ? v.data[i + j] * VOLUME : 0;
      buf[j * 2] = s; buf[j * 2 + 1] = s;
    }
    i2s.write((uint8_t *)buf, sizeof(buf));
  }
  memset(buf, 0, sizeof(buf));
  for (int i = 0; i < 16; i++) i2s.write((uint8_t *)buf, sizeof(buf));  // flush with silence
}

void sayHello() {
  count++;
  screen(true);
  Serial.println("Hello world!");
  playClip(voices[0]);
  screen(false);
}

void setup() {
  Serial.begin(115200);
  analogWrite(PIN_BL, 255);
  pinMode(PIN_BTN, INPUT_PULLUP);
  gfx->begin(40000000);
  i2s.setPins(PIN_I2S_BCLK, PIN_I2S_LRC, PIN_I2S_DIN);
  if (!i2s.begin(I2S_MODE_STD, VOICE_RATE, I2S_DATA_BIT_WIDTH_16BIT, I2S_SLOT_MODE_STEREO))
    Serial.println("I2S init failed");
  delay(300);
  sayHello();
}

void loop() {
  static bool last = HIGH;
  bool b = digitalRead(PIN_BTN);
  if (b == LOW && last == HIGH) sayHello();
  last = b;
  delay(10);
}
